## arch/arm/configs/ezx_defconfig
```kconfig
CONFIG_EXPERIMENTAL=y
CONFIG_LOCALVERSION="-370network"
# CONFIG_LOCALVERSION_AUTO is not set
CONFIG_SYSVIPC=n
CONFIG_IKCONFIG=n
CONFIG_IKCONFIG_PROC=n
CONFIG_LOG_BUF_SHIFT=14
CONFIG_BLK_DEV_INITRD=n
CONFIG_RD_BZIP2=n
CONFIG_RD_LZMA=n
CONFIG_EXPERT=y
# CONFIG_COMPAT_BRK is not set
CONFIG_SLAB=y
CONFIG_MODULES=y
CONFIG_MODULE_UNLOAD=y
CONFIG_MODULE_FORCE_UNLOAD=y
CONFIG_MODVERSIONS=n
# CONFIG_LBDAF is not set
# CONFIG_BLK_DEV_BSG is not set
# CONFIG_IOSCHED_CFQ is not set
CONFIG_IOSCHED_DEADLINE=n
CONFIG_IOSCHED_NOOP=y
CONFIG_ARCH_PXA=y
CONFIG_PXA_EZX=y
CONFIG_MACH_EZX_A1200=y
CONFIG_MACH_EZX_A780=n
CONFIG_MACH_EZX_E680=n
CONFIG_MACH_EZX_A910=n
CONFIG_MACH_EZX_E6=n
CONFIG_MACH_EZX_E2=n
# CONFIG_MACH_MOTOQ is not set
CONFIG_NO_HZ=y
CONFIG_HIGH_RES_TIMERS=y
CONFIG_PREEMPT=y
CONFIG_AEABI=y
CONFIG_ZBOOT_ROM_TEXT=0x0
CONFIG_ZBOOT_ROM_BSS=0x0
#CONFIG_CMDLINE="root=/dev/mmcblk0p3 rootfstype=ext2 init=/init ip=192.168.0.2:192.168.0.1:192.168.0.1:255.255.255.0 mem=32M@0xA0000000 mem=16M@0xAC000000 loglevel=8 ignore_loglevel debug printk.time=1 initcall_debug "
#CONFIG_CMDLINE="root=/dev/mmcblk0p2 rootfstype=ext2 init=/init ip=192.168.0.2:192.168.0.1:192.168.0.1:255.255.255.0"
CONFIG_CMDLINE="root=/dev/mmcblk0p2 rootfstype=ext2 init=/init rootwait dhash_entries=1024 ihash_entries=1024 lpj=1554432 pid_max=512 cma=0 elevator=noop quiet loglevel=0"
#CONFIG_CMDLINE="root=/dev/mmcblk0p2 rootfstype=ext2 init=/init rootwait ip=192.168.0.2:192.168.0.1:192.168.0.1:255.255.255.0 dhash_entries=1024 ihash_entries=1024 lpj=1554432 pid_max=512 cma=0 elevator=noop"
CONFIG_KEXEC=n
CONFIG_CPU_FREQ=y
CONFIG_CPU_FREQ_GOV_PERFORMANCE=y
CONFIG_CPU_FREQ_GOV_POWERSAVE=n
CONFIG_CPU_FREQ_GOV_USERSPACE=n
CONFIG_CPU_FREQ_DEFAULT_GOV_PERFORMANCE=y
CONFIG_CPU_FREQ_GOV_ONDEMAND=n
CONFIG_CPU_FREQ_GOV_CONSERVATIVE=n
CONFIG_CPU_IDLE=y
CONFIG_FPE_NWFPE=n
CONFIG_BINFMT_AOUT=n
CONFIG_BINFMT_MISC=n
CONFIG_APM_EMULATION=n
CONFIG_NET=y
CONFIG_PACKET=y
CONFIG_UNIX=y
CONFIG_INET=y
CONFIG_IP_PNP=y
CONFIG_IP_PNP_DHCP=y
CONFIG_IP_PNP_BOOTP=n
CONFIG_IP_PNP_RARP=n
CONFIG_SYN_COOKIES=n
# CONFIG_INET_XFRM_MODE_TRANSPORT is not set
# CONFIG_INET_XFRM_MODE_TUNNEL is not set
# CONFIG_INET_XFRM_MODE_BEET is not set
# CONFIG_INET_LRO is not set
# CONFIG_INET_DIAG is not set
CONFIG_INET6_AH=n
CONFIG_INET6_ESP=n
CONFIG_INET6_IPCOMP=n
CONFIG_IPV6_MIP6=n
CONFIG_IPV6_TUNNEL=n
CONFIG_IPV6_MULTIPLE_TABLES=n
CONFIG_IPV6_SUBTREES=n
CONFIG_NETFILTER=n
CONFIG_NF_CONNTRACK=n
CONFIG_NF_CONNTRACK_EVENTS=n
CONFIG_NF_CT_PROTO_SCTP=m
CONFIG_NF_CT_PROTO_UDPLITE=m
CONFIG_NF_CONNTRACK_AMANDA=m
CONFIG_NF_CONNTRACK_FTP=m
CONFIG_NF_CONNTRACK_H323=m
CONFIG_NF_CONNTRACK_IRC=m
CONFIG_NF_CONNTRACK_NETBIOS_NS=m
CONFIG_NF_CONNTRACK_PPTP=m
CONFIG_NF_CONNTRACK_SANE=m
CONFIG_NF_CONNTRACK_SIP=m
CONFIG_NF_CONNTRACK_TFTP=m
CONFIG_NF_CT_NETLINK=m
CONFIG_NETFILTER_XT_TARGET_CHECKSUM=m
CONFIG_NETFILTER_XT_TARGET_CLASSIFY=m
CONFIG_NETFILTER_XT_TARGET_IDLETIMER=m
CONFIG_NETFILTER_XT_TARGET_LED=m
CONFIG_NETFILTER_XT_TARGET_MARK=m
CONFIG_NETFILTER_XT_TARGET_NFLOG=m
CONFIG_NETFILTER_XT_TARGET_NFQUEUE=m
CONFIG_NETFILTER_XT_TARGET_TCPMSS=m
CONFIG_NETFILTER_XT_MATCH_COMMENT=m
CONFIG_NETFILTER_XT_MATCH_CONNBYTES=m
CONFIG_NETFILTER_XT_MATCH_CONNLIMIT=m
CONFIG_NETFILTER_XT_MATCH_CONNMARK=m
CONFIG_NETFILTER_XT_MATCH_CONNTRACK=m
CONFIG_NETFILTER_XT_MATCH_CPU=m
CONFIG_NETFILTER_XT_MATCH_DCCP=m
CONFIG_NETFILTER_XT_MATCH_DSCP=m
CONFIG_NETFILTER_XT_MATCH_ESP=m
CONFIG_NETFILTER_XT_MATCH_HASHLIMIT=m
CONFIG_NETFILTER_XT_MATCH_HELPER=m
CONFIG_NETFILTER_XT_MATCH_LENGTH=m
CONFIG_NETFILTER_XT_MATCH_LIMIT=m
CONFIG_NETFILTER_XT_MATCH_MAC=m
CONFIG_NETFILTER_XT_MATCH_MARK=m
CONFIG_NETFILTER_XT_MATCH_MULTIPORT=m
CONFIG_NETFILTER_XT_MATCH_POLICY=m
CONFIG_NETFILTER_XT_MATCH_PKTTYPE=m
CONFIG_NETFILTER_XT_MATCH_QUOTA=m
CONFIG_NETFILTER_XT_MATCH_REALM=m
CONFIG_NETFILTER_XT_MATCH_SCTP=m
CONFIG_NETFILTER_XT_MATCH_STATE=m
CONFIG_NETFILTER_XT_MATCH_STATISTIC=m
CONFIG_NETFILTER_XT_MATCH_STRING=m
CONFIG_NETFILTER_XT_MATCH_TCPMSS=m
CONFIG_NETFILTER_XT_MATCH_TIME=m
CONFIG_NETFILTER_XT_MATCH_U32=m
CONFIG_NF_CONNTRACK_IPV4=m
CONFIG_IP_NF_QUEUE=m
CONFIG_IP_NF_IPTABLES=m
CONFIG_IP_NF_MATCH_AH=m
CONFIG_IP_NF_MATCH_ECN=m
CONFIG_IP_NF_MATCH_TTL=m
CONFIG_IP_NF_FILTER=m
CONFIG_IP_NF_TARGET_REJECT=m
CONFIG_IP_NF_TARGET_LOG=m
CONFIG_IP_NF_TARGET_ULOG=m
CONFIG_NF_NAT=m
CONFIG_IP_NF_TARGET_MASQUERADE=m
CONFIG_IP_NF_TARGET_NETMAP=m
CONFIG_IP_NF_TARGET_REDIRECT=m
CONFIG_IP_NF_MANGLE=m
CONFIG_IP_NF_TARGET_CLUSTERIP=m
CONFIG_IP_NF_TARGET_ECN=m
CONFIG_IP_NF_TARGET_TTL=m
CONFIG_IP_NF_RAW=m
CONFIG_IP_NF_ARPTABLES=m
CONFIG_IP_NF_ARPFILTER=m
CONFIG_IP_NF_ARP_MANGLE=m
CONFIG_NF_CONNTRACK_IPV6=n
CONFIG_IP6_NF_QUEUE=n
CONFIG_IP6_NF_IPTABLES=n
CONFIG_IP6_NF_MATCH_AH=n
CONFIG_IP6_NF_MATCH_EUI64=n
CONFIG_IP6_NF_MATCH_FRAG=n
CONFIG_IP6_NF_MATCH_OPTS=n
CONFIG_IP6_NF_MATCH_HL=n
CONFIG_IP6_NF_MATCH_IPV6HEADER=n
CONFIG_IP6_NF_MATCH_MH=n
CONFIG_IP6_NF_MATCH_RT=n
CONFIG_IP6_NF_TARGET_HL=n
CONFIG_IP6_NF_TARGET_LOG=n
CONFIG_IP6_NF_FILTER=n
CONFIG_IP6_NF_TARGET_REJECT=n
CONFIG_IP6_NF_MANGLE=n
CONFIG_IP6_NF_RAW=n
CONFIG_BRIDGE=m
CONFIG_BT=y
CONFIG_BT_L2CAP=y
CONFIG_BT_SCO=n
CONFIG_BT_RFCOMM=n
CONFIG_BT_RFCOMM_TTY=n
CONFIG_BT_BNEP=m
CONFIG_BT_BNEP_MC_FILTER=m
CONFIG_BT_BNEP_PROTO_FILTER=m
CONFIG_BT_HIDP=m
CONFIG_BT_HCIBTUSB=m
CONFIG_BT_HCIBTSDIO=m
CONFIG_BT_HCIUART=y
CONFIG_BT_HCIUART_H4=y
CONFIG_BT_HCIUART_BCSP=n
CONFIG_BT_HCIBCM203X=m
CONFIG_BT_HCIBPA10X=m
CONFIG_BT_HCIBFUSB=m
CONFIG_BT_HCIVHCI=m
CONFIG_BT_MRVL=m
CONFIG_BT_MRVL_SDIO=m
# CONFIG_WIRELESS is not set
CONFIG_RFKILL=y
CONFIG_RFKILL_REGULATOR=y
# CONFIG_UEVENT_HELPER_PATH is not set
CONFIG_FW_LOADER=m
CONFIG_CONNECTOR=m
CONFIG_MTD=n
CONFIG_MTD_CMDLINE_PARTS=n
CONFIG_MTD_CHAR=y
CONFIG_MTD_BLOCK=y
CONFIG_MTD_CFI=y
CONFIG_MTD_CFI_ADV_OPTIONS=y
CONFIG_MTD_CFI_GEOMETRY=y
# CONFIG_MTD_MAP_BANK_WIDTH_1 is not set
# CONFIG_MTD_MAP_BANK_WIDTH_4 is not set
# CONFIG_MTD_CFI_I2 is not set
CONFIG_MTD_OTP=y
CONFIG_MTD_CFI_INTELEXT=y
CONFIG_MTD_PXA2XX=y
CONFIG_MTD_UBI=y
CONFIG_BLK_DEV_LOOP=m
CONFIG_BLK_DEV_CRYPTOLOOP=m
CONFIG_BLK_DEV_NBD=m
CONFIG_BLK_DEV_RAM=n
CONFIG_MISC_DEVICES=y
CONFIG_NETDEVICES=y
CONFIG_DUMMY=n
CONFIG_PPP=m
CONFIG_PPP_BSDCOMP=m
CONFIG_PPP_DEFLATE=m
CONFIG_PPP_FILTER=n
CONFIG_PPP_MULTILINK=n
CONFIG_PPP_ASYNC=m
CONFIG_PPP_SYNC_TTY=m
# CONFIG_WLAN is not set
# CONFIG_INPUT_MOUSEDEV is not set
CONFIG_INPUT_EVDEV=y
# CONFIG_KEYBOARD_ATKBD is not set
CONFIG_KEYBOARD_GPIO=y
CONFIG_KEYBOARD_PXA27x=y
# CONFIG_INPUT_MOUSE is not set
CONFIG_INPUT_TOUCHSCREEN=y
CONFIG_TOUCHSCREEN_PCAP=y
CONFIG_INPUT_MISC=y
CONFIG_INPUT_UINPUT=y
CONFIG_INPUT_PCAP=y
# CONFIG_SERIO is not set
CONFIG_LEGACY_PTY_COUNT=2
CONFIG_SERIAL_PXA=y
CONFIG_SERIAL_PXA_CONSOLE=y
# CONFIG_HW_RANDOM is not set
CONFIG_MOTO_USB_IPC=n
CONFIG_N_GSM=n
CONFIG_MOT_FEAT_TS27010MUX=n
CONFIG_TS0710_MUX=n
CONFIG_I2C=y
CONFIG_I2C_CHARDEV=n
CONFIG_I2C_PXA=y
CONFIG_SPI=y
CONFIG_SPI_PXA2XX=y
CONFIG_GPIO_SYSFS=n
CONFIG_POWER_SUPPLY=y
CONFIG_BATTERY_PCAP=y
# CONFIG_HWMON is not set
CONFIG_EZX_PCAP=y
CONFIG_REGULATOR=y
CONFIG_REGULATOR_DEBUG=n
CONFIG_REGULATOR_VIRTUAL_CONSUMER=n
CONFIG_REGULATOR_USERSPACE_CONSUMER=n
CONFIG_REGULATOR_PCAP=y
CONFIG_REGULATOR_EOC=y
CONFIG_MEDIA_SUPPORT=n
CONFIG_VIDEO_DEV=n
# CONFIG_RC_CORE is not set
# CONFIG_MEDIA_TUNER_SIMPLE is not set
# CONFIG_MEDIA_TUNER_TDA8290 is not set
# CONFIG_MEDIA_TUNER_TDA827X is not set
# CONFIG_MEDIA_TUNER_TDA18271 is not set
# CONFIG_MEDIA_TUNER_TDA9887 is not set
# CONFIG_MEDIA_TUNER_TEA5761 is not set
# CONFIG_MEDIA_TUNER_TEA5767 is not set
# CONFIG_MEDIA_TUNER_MT20XX is not set
# CONFIG_MEDIA_TUNER_MT2060 is not set
# CONFIG_MEDIA_TUNER_MT2266 is not set
# CONFIG_MEDIA_TUNER_MT2131 is not set
# CONFIG_MEDIA_TUNER_QT1010 is not set
# CONFIG_MEDIA_TUNER_XC2028 is not set
# CONFIG_MEDIA_TUNER_XC5000 is not set
# CONFIG_MEDIA_TUNER_MXL5005S is not set
# CONFIG_MEDIA_TUNER_MXL5007T is not set
# CONFIG_MEDIA_TUNER_MC44S803 is not set
CONFIG_SOC_CAMERA=n
CONFIG_SOC_CAMERA_MT9M111=n
CONFIG_VIDEO_PXA27x=n
# CONFIG_V4L_USB_DRIVERS is not set
CONFIG_RADIO_TEA5764=y
CONFIG_FB=y
CONFIG_FB_TILEBLITTING=y
CONFIG_FB_PXA=y
CONFIG_FB_PXA_OVERLAY=n
CONFIG_FB_PXA_PARAMETERS=n
CONFIG_BACKLIGHT_LCD_SUPPORT=y
# CONFIG_LCD_CLASS_DEVICE is not set
CONFIG_BACKLIGHT_CLASS_DEVICE=y
CONFIG_BACKLIGHT_PWM=y
CONFIG_FRAMEBUFFER_CONSOLE=y
CONFIG_FONTS=y
#CONFIG_FONT_MINI_4x6=y
CONFIG_FONT_8x8=y
CONFIG_SOUND=y
CONFIG_SND=y
CONFIG_SND_MIXER_OSS=y
CONFIG_SND_PCM_OSS=y
# CONFIG_SND_DRIVERS is not set
# CONFIG_SND_SPI is not set
# CONFIG_SND_USB is not set
CONFIG_SND_SOC=y
CONFIG_SND_PXA2XX_SOC=y
CONFIG_SND_PXA2XX_SOC_EZX=y
# CONFIG_USB_HID is not set
CONFIG_HID_APPLE=n
CONFIG_USB=y
# CONFIG_USB_DEVICE_CLASS is not set
#CONFIG_USB_OHCI_HCD=y
CONFIG_USB_GADGET=y
CONFIG_USB_PXA27X=y
CONFIG_USB_ETH=y
#CONFIG_USB_ACM=y
#CONFIG_USB_SERIAL=y
# CONFIG_USB_ETH_RNDIS is not set
CONFIG_USB_EOC_VBUS=y
CONFIG_MMC=y
CONFIG_MMC_UNSAFE_RESUME=y
CONFIG_SDIO_UART=n
CONFIG_MMC_PXA=y
CONFIG_MMC_SPI=n
CONFIG_NEW_LEDS=y
CONFIG_LEDS_CLASS=y
CONFIG_LEDS_LP3944=n
CONFIG_LEDS_PCAP=y
CONFIG_LEDS_REGULATOR=y
CONFIG_LEDS_TRIGGERS=n
CONFIG_LEDS_TRIGGER_TIMER=n
CONFIG_LEDS_TRIGGER_HEARTBEAT=n
CONFIG_LEDS_TRIGGER_BACKLIGHT=n
CONFIG_LEDS_TRIGGER_GPIO=n
CONFIG_LEDS_TRIGGER_DEFAULT_ON=n
CONFIG_RTC_CLASS=y
CONFIG_RTC_DRV_PCAP=y
CONFIG_RTC_DRV_PXA=n
CONFIG_EXT2_FS=y
CONFIG_EXT3_FS=n
# CONFIG_EXT3_DEFAULTS_TO_ORDERED is not set
CONFIG_REISERFS_FS=n
CONFIG_REISERFS_FS_XATTR=y
CONFIG_REISERFS_FS_POSIX_ACL=y
CONFIG_REISERFS_FS_SECURITY=y
CONFIG_XFS_FS=n
CONFIG_AUTOFS4_FS=n
CONFIG_FUSE_FS=n
CONFIG_CUSE=n
CONFIG_ISO9660_FS=n
CONFIG_JOLIET=n
CONFIG_ZISOFS=n
CONFIG_MSDOS_FS=m
CONFIG_VFAT_FS=m
CONFIG_TMPFS=y
CONFIG_JFFS2_FS=n
CONFIG_JFFS2_COMPRESSION_OPTIONS=y
CONFIG_JFFS2_LZO=y
CONFIG_JFFS2_RUBIN=y
CONFIG_UBIFS_FS=n
CONFIG_UBIFS_FS_XATTR=n
CONFIG_CRAMFS=n
CONFIG_SQUASHFS=n
CONFIG_ROMFS_FS=n
CONFIG_NFS_FS=n
CONFIG_NFS_V3=n
CONFIG_NFS_V3_ACL=n
CONFIG_NFSD=n
CONFIG_NFSD_V3=n
CONFIG_NFSD_V3_ACL=n
CONFIG_CIFS=n
CONFIG_CIFS_STATS=n
CONFIG_CIFS_WEAK_PW_HASH=n
CONFIG_CIFS_XATTR=n
CONFIG_CIFS_POSIX=n
CONFIG_NLS_CODEPAGE_437=m
CONFIG_NLS_CODEPAGE_737=m
CONFIG_NLS_CODEPAGE_775=m
CONFIG_NLS_CODEPAGE_850=m
CONFIG_NLS_CODEPAGE_852=m
CONFIG_NLS_CODEPAGE_855=m
CONFIG_NLS_CODEPAGE_857=m
CONFIG_NLS_CODEPAGE_860=m
CONFIG_NLS_CODEPAGE_861=m
CONFIG_NLS_CODEPAGE_862=m
CONFIG_NLS_CODEPAGE_863=m
CONFIG_NLS_CODEPAGE_864=m
CONFIG_NLS_CODEPAGE_865=m
CONFIG_NLS_CODEPAGE_866=m
CONFIG_NLS_CODEPAGE_869=m
CONFIG_NLS_CODEPAGE_936=m
CONFIG_NLS_CODEPAGE_950=m
CONFIG_NLS_CODEPAGE_932=m
CONFIG_NLS_CODEPAGE_949=m
CONFIG_NLS_CODEPAGE_874=m
CONFIG_NLS_ISO8859_8=m
CONFIG_NLS_CODEPAGE_1250=m
CONFIG_NLS_CODEPAGE_1251=m
CONFIG_NLS_ASCII=m
CONFIG_NLS_ISO8859_1=m
CONFIG_NLS_ISO8859_2=m
CONFIG_NLS_ISO8859_3=m
CONFIG_NLS_ISO8859_4=m
CONFIG_NLS_ISO8859_5=m
CONFIG_NLS_ISO8859_6=m
CONFIG_NLS_ISO8859_7=m
CONFIG_NLS_ISO8859_9=m
CONFIG_NLS_ISO8859_13=m
CONFIG_NLS_ISO8859_14=m
CONFIG_NLS_ISO8859_15=m
CONFIG_NLS_KOI8_R=m
CONFIG_NLS_KOI8_U=m
CONFIG_NLS_UTF8=m
CONFIG_DEBUG_FS=n
CONFIG_DETECT_HUNG_TASK=n
# CONFIG_SCHED_DEBUG is not set
CONFIG_DEBUG_RT_MUTEXES=n
CONFIG_PROVE_LOCKING=n
# CONFIG_FTRACE is not set
CONFIG_DEBUG_USER=n
CONFIG_CRYPTO_NULL=n
CONFIG_CRYPTO_CRYPTD=n
CONFIG_CRYPTO_TEST=n
CONFIG_CRYPTO_LRW=n
CONFIG_CRYPTO_PCBC=n
CONFIG_CRYPTO_XTS=n
CONFIG_CRYPTO_XCBC=n
CONFIG_CRYPTO_VMAC=n
CONFIG_CRYPTO_GHASH=n
CONFIG_CRYPTO_MICHAEL_MIC=n
CONFIG_CRYPTO_SHA256=n
CONFIG_CRYPTO_SHA512=n
CONFIG_CRYPTO_TGR192=n
CONFIG_CRYPTO_BLOWFISH=n
CONFIG_CRYPTO_CAST5=n
CONFIG_CRYPTO_CAST6=n
CONFIG_CRYPTO_FCRYPT=n
CONFIG_CRYPTO_KHAZAD=n
CONFIG_CRYPTO_SEED=n
CONFIG_CRYPTO_SERPENT=n
CONFIG_CRYPTO_TEA=n
CONFIG_CRYPTO_TWOFISH=n
# CONFIG_CRYPTO_ANSI_CPRNG is not set

CONFIG_STAGING=y
CONFIG_ANDROID=y
CONFIG_ANDROID_OLD_OPENBINDER_IPC=y
CONFIG_ANDROID_OPENBINDER_IPC=n
CONFIG_ANDROID_BINDER_IPC=n
CONFIG_ANDROID_LOGGER=y
CONFIG_ANDROID_INTF_ALARM_DEV=y
CONFIG_ANDROID_INTF_ALARM=y
CONFIG_ANDROID_LOW_MEMORY_KILLER=y
CONFIG_ASHMEM=y
CONFIG_MMU=y
CONFIG_SHMEM=y

CONFIG_DNOTIFY=n
CONFIG_INOTIFY=y

#ram configs
CONFIG_SERIO=n
CONFIG_LEGACY_PTYS=n
CONFIG_OUTER_CACHE=n
CONFIG_LBDAF=n
CONFIG_BLK_DEV_BSG=n
CONFIG_IOSCHED_CFQ=n
CONFIG_BRIDGE_IGMP_SNOOPING=n
CONFIG_XFRM=n
CONFIG_FRAME_POINTER=n
CONFIG_DEVKMEM=n
CONFIG_DEVMEM=n
CONFIG_SQUASHFS=n
CONFIG_SQUASHFS_ZLIB=n
CONFIG_ROMFS_ON_BLOCK=n
CONFIG_ROMFS_BACKED_BY_BLOCK=n
CONFIG_EXT3_FS_XATTR=n
CONFIG_NETWORK_FILESYSTEMS=n
CONFIG_IWMMXT=n
CONFIG_FORCE_MAX_ZONEORDER=9
CONFIG_VM_EVENT_COUNTERS=n
CONFIG_BASE_SMALL=1
CONFIG_BASE_FULL=n
CONFIG_BUG=n
CONFIG_AIO=n
CONFIG_PROC_KCORE=n
CONFIG_ELF_CORE=n
CONFIG_LOCKDEP=n
CONFIG_LOCKDEP_SUPPORT=n
CONFIG_KALLSYMS=n
CONFIG_STACKTRACE=n
CONFIG_DEBUG_KERNEL=n
CONFIG_DEBUG_BUGVERBOSE=n
CONFIG_DEBUG_MEMORY_INIT=n
CONFIG_PRINTK_TIME=n
CONFIG_ENABLE_WARN_DEPRECATED=n
CONFIG_ENABLE_MUST_CHECK=n
CONFIG_DEBUG_PREEMPT=n
CONFIG_DEBUG_SPINLOCK=n
CONFIG_DEBUG_MUTEXES=n
CONFIG_DEBUG_LOCK_ALLOC=n
CONFIG_PROVE_LOCKING=n
CONFIG_TRACE_IRQFLAGS=n
CONFIG_HAVE_FUNCTION_TRACER=n
CONFIG_HAVE_FUNCTION_GRAPH_TRACER=n
CONFIG_HAVE_DYNAMIC_FTRACE=n
CONFIG_HAVE_FTRACE_MCOUNT_RECORD=n
CONFIG_HAVE_C_RECORDMCOUNT=n
CONFIG_TRACING_SUPPORT=n
CONFIG_HAVE_ARCH_KGDB=n

CONFIG_OABI_COMPAT=y

#emulation
#qemu-system-arm -m 48M -machine versatilepb -nographic -kernel /opt/chroot/root/openezx/arch/arm/boot/zImage -append "console=ttyAMA0,115200" -audio driver=none
#CONFIG_ARCH_VERSATILE=y
#CONFIG_ARCH_VERSATILE_PB=y
#CONFIG_SERIAL_AMBA_PL011=y
#CONFIG_SERIAL_AMBA_PL011_CONSOLE=y

CONFIG_SUSPEND=y
CONFIG_SUSPEND_FREEZER=y
CONFIG_PM=y
CONFIG_PM_RUNTIME=n
CONFIG_WAKELOCK=y
CONFIG_WAKELOCK_STAT=y
CONFIG_USER_WAKELOCK=y
CONFIG_EARLYSUSPEND=y
CONFIG_FB_EARLYSUSPEND=y

CONFIG_ANDROID_VIBRATOR_COMPAT=y
CONFIG_ANDROID_POWER_COMPAT=y
CONFIG_ANDROID_BACKLIGHT_COMPAT=y
CONFIG_ANDROID_EVENT0_COMPAT=y
CONFIG_ANDROID_EZX_EAC=y
```
